## main/Kconfig.projbuild
```kconfig
menu "DesktopScreen Configuration"

# i2c master
    menu "I2C Master"
        config I2C_MASTER_SCL
            int "SCL GPIO Num"
            default 16
            help
                GPIO number for I2C Master clock line.

        config I2C_MASTER_SDA
            int "SDA GPIO Num"
            default 17
            help
                GPIO number for I2C Master data line.

        config I2C_MASTER_PORT_NUM
            int "Port Number"
            default 1
            help
                Port number for I2C Master device.

        config I2C_MASTER_FREQUENCY
            int "Master Frequency"
            default 100000
            help
                I2C Speed of Master device.
    endmenu

# wifi ap
    menu "Wifi AP"

        config ESP_AP_WIFI_SSID
            string "WiFi SSID"
            default "screen"
            help
                SSID (network name) for the example to connect to.

        config ESP_AP_WIFI_PASSWORD
            string "WiFi Password"
            default "123456789"
            help
                WiFi password (WPA or WPA2) for the example to use.
        config ESP_AP_WIFI_CHANNEL
            int "WiFi Channel"
            range 1 13
            default 1
            help
                WiFi channel (network channel) for the example to use.

        config ESP_AP_MAX_STA_CONN
            int "Maximal STA connections"
            default 4
            help
                Max number of the STA connects to AP.

    endmenu

    
endmenu
```
